## boards/seeed/xiao_ble/Kconfig
```kconfig
# Copyright (c) 2024 Nordic Semiconductor ASA
# SPDX-License-Identifier: Apache-2.0

if BOARD_XIAO_BLE

config BOARD_NEED_SERIAL_BACKEND_CDC_ACM
	bool
	default y

endif # BOARD_XIAO_BLE
```

## boards/seeed/xiao_ble/Kconfig.defconfig
```kconfig
# XIAO BLE board configuration

# Copyright (c) 2022 Marcin Niestroj
# SPDX-License-Identifier: Apache-2.0

if BOARD_XIAO_BLE

config BT_CTLR
	default BT

source "${ZEPHYR_BASE}/boards/common/usb/Kconfig.cdc_acm_serial"

endif # BOARD_XIAO_BLE
```

## boards/sensoan/sgw2/Kconfig
```kconfig
# SGW-2 board configuration
#
# Copyright (c) 2019 Nordic Semiconductor ASA
# Copyright (c) 2024 Sensoan Oy
#
# SPDX-License-Identifier: Apache-2.0

if BOARD_SGW2_NRF9160 || BOARD_SGW2_NRF9160_NS

config BOARD_INIT_PRIORITY
	int "Initialization priority for board configuration"
	default 80

endif # BOARD_SGW2_NRF9160 || BOARD_SGW2_NRF9160_NS

if BOARD_SGW2_NRF5340_CPUAPP || BOARD_SGW2_NRF5340_CPUAPP_NS || BOARD_SGW2_NRF5340_CPUNET

if BOARD_SGW2_NRF5340_CPUAPP || BOARD_SGW2_NRF5340_CPUAPP_NS

config BOARD_ENABLE_DCDC_APP
	bool "Application MCU DCDC converter"
	select SOC_DCDC_NRF53X_APP
	default y

config BOARD_ENABLE_DCDC_NET
	bool "Network MCU DCDC converter"
	select SOC_DCDC_NRF53X_NET
	default y

config BOARD_ENABLE_CPUNET
	bool "NRF53 Network MCU"
	select SOC_NRF_GPIO_FORWARDER_FOR_NRF5340 if \
		$(dt_compat_enabled,$(DT_COMPAT_NORDIC_NRF_GPIO_FORWARDER))
	help
	  This option enables releasing the Network 'force off' signal, which
	  as a consequence will power up the Network MCU during system boot.
	  Additionally, the option allocates GPIO pins that will be used by UARTE
	  of the Network MCU.
	  Note: GPIO pin allocation can only be configured by the secure Application
	  MCU firmware, so when this option is used with the non-secure version of
	  the board, the application needs to take into consideration, that the
	  secure firmware image must already have configured GPIO allocation for the
	  Network MCU.
	default y if (BT || NRF_802154_SER_HOST)

config DOMAIN_CPUNET_BOARD
	string
	default "sgw2/nrf5340/cpunet"
	depends on BOARD_ENABLE_CPUNET
	help
	  The board which will be used for CPUNET domain when creating a multi
	  image application where one or more images should be located on
	  another board. For example hci_rpmsg on the nRF5340_cpunet for
	  Bluetooth applications.

endif #  BOARD_SGW2_NRF5340_CPUAPP || BOARD_SGW2_NRF5340_CPUAPP_NS

config DOMAIN_CPUAPP_BOARD
	string
	default "sgw2/nrf5340/cpuapp"
	depends on BOARD_SGW2_NRF5340_CPUNET
	help
	  The board which will be used for CPUAPP domain when creating a multi
	  image application where one or more images should be located on
	  another board.

endif # BOARD_SGW2_NRF5340_CPUAPP || BOARD_SGW2_NRF5340_CPUAPP_NS || BOARD_SGW2_NRF5340_CPUNET

if DT_HAS_NORDIC_NRF_SPIM_ENABLED && DT_HAS_JEDEC_SPI_NOR_ENABLED

config SGW2_SPI_FLASH
	bool "Imply config options for external flash"
	imply FLASH
	imply MULTITHREADING
	imply SPI_NOR
	default y

endif

module=BOARD
module-dep=LOG
module-str=Log level for board
source "${ZEPHYR_BASE}/subsys/logging/Kconfig.template.log_config"
```

## boards/sensoan/sgw2/Kconfig.defconfig
```kconfig
# SGW2 board configuration
#
# Copyright (c) 2018 Nordic Semiconductor ASA
# Copyright (c) 2024 Sensoan Oy
#
# SPDX-License-Identifier: Apache-2.0

if BOARD_SGW2_NRF9160 || BOARD_SGW2_NRF9160_NS

# By default, if we build for a Non-Secure version of the board,
# enable building with TF-M as the Secure Execution Environment.
config BUILD_WITH_TFM
	default y if BOARD_SGW2_NRF9160_NS

if BUILD_WITH_TFM

# By default, if we build with TF-M, instruct build system to
# flash the combined TF-M (Secure) & Zephyr (Non Secure) image
config TFM_FLASH_MERGED_BINARY
	bool
	default y

endif # BUILD_WITH_TFM

# For the secure version of the board the firmware is linked at the beginning
# of the flash, or into the code-partition defined in DT if it is intended to
# be loaded by MCUboot. If the secure firmware is to be combined with a non-
# secure image (TRUSTED_EXECUTION_SECURE=y), the secure FW image shall always
# be restricted to the size of its code partition.
# For the non-secure version of the board, the firmware
# must be linked into the code-partition (non-secure) defined in DT, regardless.
# Apply this configuration below by setting the Kconfig symbols used by
# the linker according to the information extracted from DT partitions.

if BOARD_SGW2_NRF9160 && TRUSTED_EXECUTION_SECURE

config FLASH_LOAD_SIZE
	default $(dt_chosen_reg_size_hex,$(DT_CHOSEN_Z_CODE_PARTITION))

endif # BOARD_SGW2_NRF9160 && TRUSTED_EXECUTION_SECURE

if BOARD_SGW2_NRF9160_NS

config FLASH_LOAD_OFFSET
	default $(dt_chosen_reg_addr_hex,$(DT_CHOSEN_Z_CODE_PARTITION))

config FLASH_LOAD_SIZE
	default $(dt_chosen_reg_size_hex,$(DT_CHOSEN_Z_CODE_PARTITION))

endif # BOARD_SGW2_NRF9160_NS

config BT_HCI_VS
	default y if BT

config HW_STACK_PROTECTION
	default ARCH_HAS_STACK_PROTECTION

config I2C
	default $(dt_compat_on_bus,$(DT_COMPAT_NXP_PCAL6408A),i2c)

endif # BOARD_NRF9160DK_NRF9160 || BOARD_NRF9160DK_NRF9160_NS

if  BOARD_SGW2_NRF5340_CPUAPP || BOARD_SGW2_NRF5340_CPUAPP_NS

# By default, if we build for a Non-Secure version of the board,
# enable building with TF-M as the Secure Execution Environment.
config BUILD_WITH_TFM
	default y if BOARD_SGW2_NRF5340_CPUAPP_NS

if BUILD_WITH_TFM

# By default, if we build with TF-M, instruct build system to
# flash the combined TF-M (Secure) & Zephyr (Non Secure) image
config TFM_FLASH_MERGED_BINARY
	bool
	default y

endif # BUILD_WITH_TFM

# Code Partition:
#
# For the secure version of the board the firmware is linked at the beginning
# of the flash, or into the code-partition defined in DT if it is intended to
# be loaded by MCUboot. If the secure firmware is to be combined with a non-
# secure image (TRUSTED_EXECUTION_SECURE=y), the secure FW image shall always
# be restricted to the size of its code partition.
#
# For the non-secure version of the board, the firmware
# must be linked into the code-partition (non-secure) defined in DT, regardless.
# Apply this configuration below by setting the Kconfig symbols used by
# the linker according to the information extracted from DT partitions.

# SRAM Partition:
#
# If the secure firmware is to be combined with a non-secure image
# (TRUSTED_EXECUTION_SECURE=y), the secure FW image SRAM shall always
# be restricted to the secure image SRAM partition (sram-secure-partition).
# Otherwise (if TRUSTED_EXECUTION_SECURE is not set) the whole zephyr,sram
# may be used by the image.
#
# For the non-secure version of the board, the firmware image SRAM is
# always restricted to the allocated non-secure SRAM partition.
#
# Workaround for not being able to have commas in macro arguments
DT_CHOSEN_Z_CODE_PARTITION := zephyr,code-partition
DT_CHOSEN_Z_SRAM_PARTITION := zephyr,sram-secure-partition

if BOARD_SGW2_NRF5340_CPUAPP && TRUSTED_EXECUTION_SECURE

config FLASH_LOAD_SIZE
	default $(dt_chosen_reg_size_hex,$(DT_CHOSEN_Z_CODE_PARTITION))

config SRAM_SIZE
	default $(dt_chosen_reg_size_int,$(DT_CHOSEN_Z_SRAM_PARTITION),0,K)

endif # BOARD_SGW2_NRF5340_CPUAPP && TRUSTED_EXECUTION_SECURE

if BOARD_SGW2_NRF5340_CPUAPP_NS

config FLASH_LOAD_OFFSET
	default $(dt_chosen_reg_addr_hex,$(DT_CHOSEN_Z_CODE_PARTITION))

config FLASH_LOAD_SIZE
	default $(dt_chosen_reg_size_hex,$(DT_CHOSEN_Z_CODE_PARTITION))

endif # BOARD_SGW2_NRF5340_CPUAPP_NS

endif # BOARD_SGW2_NRF5340_CPUAPP || BOARD_SGW2_NRF5340_CPUAPP_NS

config MBOX_NRFX_IPC
	default MBOX

if BOARD_SGW2_NRF5340_CPUAPP || BOARD_SGW2_NRF5340_CPUAPP_NS

config BT_HCI_IPC
	default y if BT

config HEAP_MEM_POOL_SIZE
	default 4096 if BT_HCI_IPC

endif #  BOARD_SGW2_NRF5340_CPUAPP || BOARD_SGW2_NRF5340_CPUAPP_NS

if BOARD_SGW2_NRF5340_CPUNET

config BT_CTLR
	default y if BT

endif # BOARD_SGW2_NRF5340_CPUNET
```

## boards/sensoan/sgw2/sgw2_nrf9160_defconfig
```kconfig
# Enable MPU
CONFIG_ARM_MPU=y

# Enable TrustZone-M
CONFIG_ARM_TRUSTZONE_M=y

# Enable PINCTRL
CONFIG_PINCTRL=y

# Enable GPIO
CONFIG_GPIO=y

# Enable UARTE
CONFIG_SERIAL=y

# Enable console
CONFIG_CONSOLE=y
CONFIG_UART_CONSOLE=y
```

## boards/sparkfun/artemis_nano/Kconfig.artemis_nano
```kconfig
# SPDX-License-Identifier: GPL-2.0
# Copyright (c) 2024 Ali Sarlak

config BOARD_ARTEMIS_NANO
	select SOC_APOLLO3_BLUE

config FLASH_BASE_ADDRESS
	hex
	default 0x10000
```

## boards/weact/mini_stm32h743/Kconfig
```kconfig
# Copyright (c) 2024 Nordic Semiconductor ASA
# SPDX-License-Identifier: Apache-2.0

if BOARD_MINI_STM32H743

config BOARD_NEED_SERIAL_BACKEND_CDC_ACM
	bool
	default y

endif # BOARD_MINI_STM32H743
```

## drivers/fpga/Kconfig.ice40
```kconfig
# Copyright (c) 2022 Meta
# Copyright (c) 2024 SILA Embedded Solutions GmbH
# SPDX-License-Identifier: Apache-2.0

config ICE40_FPGA
	bool "Lattice iCE40 fpga driver [EXPERIMENTAL]"
	select EXPERIMENTAL
	imply CRC
	depends on SPI
	help
	  Enable support for the Lattice iCE40 fpga driver.

if ICE40_FPGA

config ICE40_FGPA_LOAD_MODE_SPI
	bool "SPI load mode for the iCE40 fpga driver"
	default y
	help
	  Enable support for the SPI load mode of the iCE40 fpga driver.
	  This will be possible to use only on more high performance MCUs,
	  as otherwise the timing constraints of the iCE40 cannot be met.

config ICE40_FGPA_LOAD_MODE_GPIO
	bool "GPIO bitbang load mode for the iCE40 fpga driver"
	default n
	help
	  Enable support for the GPIO bitbang load mode of the iCE40 fpga
	  driver. This will ensure that also no low performance MCUs the
	  timing constraints for the iCE40 are met.

endif # ICE40_FPGA
```

## dts/bindings/bluetooth/renesas,bt-hci-da1453x.yaml
```yaml
# Copyright 2024 Ian Morris
# SPDX-License-Identifier: Apache-2.0

description: Bluetooth HCI for Renesas DA1453x based controller

compatible: "renesas,bt-hci-da1453x"

include: bt-hci.yaml

properties:
  reset-gpios:
    type: phandle-array
    description: |
      This gpio is used to reset the DA1453x.

  reset-assert-duration-ms:
    type: int
    description: |
      Minimum duration to activate the reset-gpios pin.
      If not specified no delay beyond the code path execution time is guaranteed.

  boot-duration-ms:
    type: int
    default: 200
    description: |
      Minimum time to wait for the DA1453x to boot following a hardware reset.
```

## dts/bindings/clock/st,stm32-clock-mco.yaml
```yaml
#
# Copyright (c) 2024, Joakim Andersson
#
# SPDX-License-Identifier: Apache-2.0
#

compatible: "st,stm32-clock-mco"

description: |
        STM32 Microcontroller Clock Output (MCO)

        Used to output a clock signal from the MCU to a GPIO pin.
        The selected signal goes through a configurable prescaler before output.
        The clocks property defines the MCOx source clock. Several are possible
        for MCO1 and/or MCO2 depending on the stm32 serie.
        The prescaler is directly the value from 1 to n depending on the stm32 serie
        and will be converted in LL_RCC_MCO2_DIV_n

        Example:
                &mco1 {
                        clocks = <&rcc STM32_SRC_LSE MCO1_SEL(7)>;
                        prescaler = <5>;
                        pinctrl-0 = <&rcc_mco_pa8>;
                        pinctrl-names = "default";
                        status = "okay";
                };

include: [base.yaml, pinctrl-device.yaml]

properties:

  clocks:
    required: true

  prescaler:
    type: int
    required: true

  pinctrl-0:
    required: true

  pinctrl-names:
    required: true
```

## dts/bindings/video/zephyr,video-emul-rx.yaml
```yaml
# Copyright 2024 tinyVision.ai Inc.
# SPDX-License-Identifier: Apache-2.0

description: Emulated Video DMA engine for testing purpose

compatible: "zephyr,video-emul-rx"

include: base.yaml

child-binding:
  child-binding:
    include: video-interfaces.yaml
    properties:
      reg:
        type: int
        enum:
          - 0 # for output endpoint
          - 1 # for input endpoint
```

## modules/Kconfig.renesas_rdp
```kconfig
# Renesas RDP HAL config

# Copyright (c) 2024 Renesas Electronics Corporation
# SPDX-License-Identifier: Apache-2.0

config HAS_RENESAS_RX_RDP
	bool
	help
	  Enable Renesas RX RDP support

if HAS_RENESAS_RX_RDP

config USE_RX_RDP_MPC
	bool
	help
	  Enable RX RDP MPC driver

config USE_RX_RDP_GPIO
	bool
	help
	  Enable RX RDP MPC driver

endif # HAS_RENESAS_RX_RDP
```

## samples/drivers/rtc/sample.yaml
```yaml
sample:
  name: Real-Time Clock Sample
tests:
  sample.drivers.rtc:
    harness: rtc
    tags:
      - samples
      - rtc
    depends_on:
      - rtc
```

## samples/sensor/accel_trig/sample.yaml
```yaml
sample:
  name: Accelerometer trigger sample
common:
  tags: sensors
  harness: console
  harness_config:
    type: one_line
    regex:
      - "^\\s*[0-9A-Za-z_,+-.]*@[0-9A-Fa-f]* \\[m\/s\\^2\\]:    \
        \\(\\s*-?[0-9\\.]*,\\s*-?[0-9\\.]*,\\s*-?[0-9\\.]*\\)$"
tests:
  sample.sensor.accel_trig:
    filter: dt_alias_exists("accel0")
    integration_platforms:
      - frdm_k64f                       # fxos8700
  sample.sensor.accel_trig.adxl362-trigger:
    extra_args:
      - SHIELD=eval_adxl362_ardz
      - EXTRA_CONF_FILE=adxl362-trigger.conf
      - SNIPPET=rtt-tracing;rtt-console
    platform_allow:
      - apard32690/max32690/m4
```

## soc/mediatek/mtk_adsp/Kconfig.soc
```kconfig
# Copyright 2024 The ChromiumOS Authors
# SPDX-License-Identifier: Apache-2.0

config SOC_FAMILY_MTK_ADSP
	bool

config SOC_SERIES_MT8195_ADSP
	bool
	select SOC_FAMILY_MTK_ADSP
	help
	  Mediatek MT8195 Audio DSP

config SOC_SERIES_MT818X_ADSP
	bool
	select SOC_FAMILY_MTK_ADSP
	help
	  Mediatek MT818x Audio DSPs

config SOC_SERIES_MT8196_ADSP
	bool
	select SOC_FAMILY_MTK_ADSP
	help
	  Mediatek MT8196 Audio DSPs

config SOC_MT8195_ADSP
	bool
	select SOC_SERIES_MT8195_ADSP

config SOC_MT8186_ADSP
	bool
	select SOC_SERIES_MT818X_ADSP

config SOC_MT8188_ADSP
	bool
	select SOC_SERIES_MT818X_ADSP

config SOC_MT8196_ADSP
	bool
	select SOC_SERIES_MT8196_ADSP

config SOC
	default "mt8195_adsp" if SOC_MT8195_ADSP
	default "mt8186_adsp" if SOC_MT8186_ADSP
	default "mt8188_adsp" if SOC_MT8188_ADSP
	default "mt8196_adsp" if SOC_MT8196_ADSP
```

## soc/nordic/common/Kconfig
```kconfig
# Copyright (c) 2024 Nordic Semiconductor ASA
# SPDX-License-Identifier: Apache-2.0

config HAS_NORDIC_DMM
	bool

config MRAM_LATENCY
	bool "MRAM latency manager"
	depends on NRFS_HAS_MRAM_SERVICE
	select ONOFF
	select NRFS_MRAM_SERVICE_ENABLED

config MRAM_LATENCY_SYNC_TIMEOUT
	int "Timeout in synchronous request"
	default 1000
	help
	  Timeout is given in milliseconds.

module = MRAM_LATENCY
module-str = mram_latency
source "subsys/logging/Kconfig.template.log_config"

rsource "vpr/Kconfig"
```

## soc/nordic/nrf54l/Kconfig.defconfig.nrf54l_05_10_15_cpuapp
```kconfig
# Nordic Semiconductor nRF54 L05, L10 and L15 MCUs

# Copyright (c) 2024 Nordic Semiconductor ASA
# SPDX-License-Identifier: Apache-2.0

if SOC_NRF54L_05_10_15_CPUAPP

config NUM_IRQS
	default 271

endif # SOC_NRF54L_05_10_15_CPUAPP
```

## tests/posix/thread_base/testcase.yaml
```yaml
common:
  tags:
    - posix
    - thread_base
  min_ram: 64
  timeout: 240
  # 1 tier0 platform per supported architecture
  platform_key:
    - arch
    - simulation
  filter: not CONFIG_NATIVE_LIBC
tests:
  portability.posix.thread_base: {}
  portability.posix.thread_base.minimal:
    extra_configs:
      - CONFIG_MINIMAL_LIBC=y
  portability.posix.thread_base.newlib:
    filter: TOOLCHAIN_HAS_NEWLIB == 1
    extra_configs:
      - CONFIG_NEWLIB_LIBC=y
  portability.posix.thread_base.picolibc:
    tags: picolibc
    filter: CONFIG_PICOLIBC_SUPPORTED
    extra_configs:
      - CONFIG_PICOLIBC=y
  portability.posix.thread_base.dynamic_stack:
    extra_configs:
      - CONFIG_DYNAMIC_THREAD=y
      - CONFIG_THREAD_STACK_INFO=y
      - CONFIG_HEAP_MEM_POOL_SIZE=16384
  portability.posix.thread_base.static_stack:
    extra_configs:
      - CONFIG_DYNAMIC_THREAD=n
      - CONFIG_THREAD_STACK_INFO=n
```
