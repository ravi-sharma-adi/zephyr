## tests/subsys/fs/ext2/boards/ek_ra8m1.conf
```kconfig
CONFIG_DISK_DRIVERS=y
CONFIG_DISK_DRIVER_SDMMC=y
CONFIG_DISK_DRIVER_RAM=n
CONFIG_FLASH=n
```

## tests/subsys/fs/fat_fs_api/boards/ek_ra8d1.conf
```kconfig
CONFIG_DISK_ACCESS=y
CONFIG_DISK_DRIVER_SDMMC=y
CONFIG_FAT_FILESYSTEM_ELM=y
CONFIG_GPIO=y
CONFIG_MAIN_STACK_SIZE=4096
CONFIG_LOG=y

CONFIG_DISK_DRIVER_RAM=n
CONFIG_DISK_DRIVER_FLASH=n
CONFIG_FS_FATFS_HAS_RTC=n
```
