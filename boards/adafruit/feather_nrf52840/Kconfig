## boards/adafruit/feather_nrf52840/Kconfig
```kconfig
# Copyright (c) 2024 Nordic Semiconductor ASA
# SPDX-License-Identifier: Apache-2.0

if BOARD_ADAFRUIT_FEATHER_NRF52840_NRF52840_UF2 || BOARD_ADAFRUIT_FEATHER_NRF52840_NRF52840_SENSE_UF2

config BOARD_NEED_SERIAL_BACKEND_CDC_ACM
	bool
	default y

endif
```

## boards/adafruit/itsybitsy/Kconfig.defconfig
```kconfig
# Adafruit ItsyBitsy nRF52840 Express board configuration

# Copyright (c) 2022 Embla Flatlandsmo <embla.flatlandsmo@gmail.com>
# SPDX-License-Identifier: Apache-2.0

if BOARD_ADAFRUIT_ITSYBITSY

config BT_CTLR
	default BT

source "${ZEPHYR_BASE}/boards/common/usb/Kconfig.cdc_acm_serial"

endif # BOARD_ADAFRUIT_ITSYBITSY
```

## boards/adi/athenaevkit/Kconfig.athenaevkit
```kconfig
# ATHENAEVKIT boards configuration

# Copyright (c) 2024 Analog Devices, Inc.
# SPDX-License-Identifier: Apache-2.0

config BOARD_ATHENAEVKIT
	select SOC_ANDES_AE350 if BOARD_ATHENAEVKIT_AE350
```

## boards/adi/athenaevkit/Kconfig.defconfig
```kconfig
# ATEHNAEVKIT boards configuration

# Copyright (c) 2024 Analog Devices, Inc.
# SPDX-License-Identifier: Apache-2.0

if BOARD_ATHENAEVKIT

config SRAM_SIZE
    int "RAM size in kilobytes"
    default 512
    depends on SOC_ANDES_AE350

endif # BOARD_ATHENAEVKIT
```

## boards/adi/athenaevkit/board.yml
```yaml
# Copyright (c) 2024 Analog Devices, Inc.
# SPDX-License-Identifier: Apache-2.0
board:
  name: athenaevkit
  full_name: ADI Athena
  vendor: adi
  socs:
      - name: ae350
```

## boards/arduino/opta/Kconfig
```kconfig
# Copyright (c) 2024 Nordic Semiconductor ASA
# SPDX-License-Identifier: Apache-2.0

if BOARD_ARDUINO_OPTA_STM32H747XX_M7

config BOARD_NEED_SERIAL_BACKEND_CDC_ACM
	bool
	default y

endif # BOARD_ARDUINO_OPTA_STM32H747XX_M7
```

## boards/atmarktechno/degu_evk/Kconfig
```kconfig
# Copyright (c) 2024 Nordic Semiconductor ASA
# SPDX-License-Identifier: Apache-2.0

if BOARD_DEGU_EVK

config BOARD_NEED_SERIAL_BACKEND_CDC_ACM
	bool
	default y

endif # BOARD_DEGU_EVK
```

## boards/atmarktechno/degu_evk/Kconfig.defconfig
```kconfig
# Degu Evaluation Kit configuration

# Copyright (c) 2019 Atmark Techno, Inc.
# SPDX-License-Identifier: Apache-2.0

if BOARD_DEGU_EVK

source "${ZEPHYR_BASE}/boards/common/usb/Kconfig.cdc_acm_serial"

endif # BOARD_DEGU_EVK
```

## boards/croxel/croxel_cx1825/Kconfig
```kconfig
# Copyright (c) 2024 Nordic Semiconductor ASA
# SPDX-License-Identifier: Apache-2.0

if BOARD_CROXEL_CX1825

config BOARD_NEED_SERIAL_BACKEND_CDC_ACM
	bool
	default y

endif # BOARD_CROXEL_CX1825
```

## boards/croxel/croxel_cx1825/Kconfig.defconfig
```kconfig
# Copyright (c) 2024 Luis Ubieda
# SPDX-License-Identifier: Apache-2.0

if BOARD_CROXEL_CX1825

config BT_CTLR
	default BT

source "${ZEPHYR_BASE}/boards/common/usb/Kconfig.cdc_acm_serial"

endif # BOARD_CROXEL_CX1825
```

## boards/ct/ctcc/Kconfig
```kconfig
# CTHINGS.CO Connectivity Card board configuration

# Copyright (c) 2024 CTHINGS.CO
# SPDX-License-Identifier: Apache-2.0

config BOARD_NEED_SERIAL_BACKEND_CDC_ACM
	bool
	default y
	depends on BOARD_CTCC_NRF52840
```

## boards/ct/ctcc/Kconfig.defconfig
```kconfig
# CTHINGS.CO Connectivity Card board configuration

# Copyright (c) 2024 CTHINGS.CO
# SPDX-License-Identifier: Apache-2.0

if BOARD_CTCC_NRF52840

config BT_CTLR
	default BT

source "${ZEPHYR_BASE}/boards/common/usb/Kconfig.cdc_acm_serial"

endif # BOARD_CTCC_NRF52840
```

## boards/ezurio/bl654_usb/Kconfig
```kconfig
# BL654 USB adapter board configuration

# Copyright (c) 2021 Laird Connectivity
# SPDX-License-Identifier: Apache-2.0

if BOARD_BL654_USB

config BOARD_NEED_SERIAL_BACKEND_CDC_ACM
	bool
	default y

endif
```

## boards/kws/pico_spe/board.yml
```yaml
board:
  name: pico_spe
  full_name: SinglePairEthernet Pico
  vendor: kws
  socs:
  - name: rp2040
```

## boards/lilygo/ttgo_t7v1_5/Kconfig.ttgo_t7v1_5
```kconfig
# Copyright 2024 Tobias Kässer <t.kaesser@gmail.com>
# SPDX-License-Identifier: Apache-2.0

config BOARD_TTGO_T7V1_5
	select SOC_ESP32

config ESP_WIFI_MAX_THREAD_PRIORITY
    int "ESP WiFi Maximum Thread Priority"
    default 3
```

## boards/makerbase/mks_canable_v20/board.yml
```yaml
board:
  name: mks_canable_v20
  full_name: MKS Canable V2.0
  vendor: makerbase
  socs:
    - name: stm32g431xx
```

## boards/mediatek/mt8186_adsp/Kconfig.mt8186_adsp
```kconfig
# Copyright 2024 The ChromiumOS Authors
# SPDX-License-Identifier: Apache-2.0

config BOARD_MT8186_ADSP
	select SOC_MT8186_ADSP
```

## boards/mediatek/mt8188_adsp/Kconfig.mt8188_adsp
```kconfig
# Copyright 2024 The ChromiumOS Authors
# SPDX-License-Identifier: Apache-2.0

config BOARD_MT8188_ADSP
	select SOC_MT8188_ADSP
```

## boards/mediatek/mt8196_adsp/Kconfig.mt8196_adsp
```kconfig
# Copyright 2024 The ChromiumOS Authors
# SPDX-License-Identifier: Apache-2.0

config BOARD_MT8196_ADSP
	select SOC_MT8196_ADSP
```

## boards/mediatek/mt8196_adsp/board.yml
```yaml
boards:
  - name: mt8196_adsp
    vendor: mediatek
    socs:
      - name: mt8196_adsp
```

## boards/mikroe/stm32_m4_clicker/Kconfig
```kconfig
# Copyright (c) 2024 Nordic Semiconductor ASA
# SPDX-License-Identifier: Apache-2.0

if BOARD_MIKROE_STM32_M4_CLICKER

config BOARD_NEED_SERIAL_BACKEND_CDC_ACM
	bool
	default y

endif # BOARD_MIKROE_STM32_M4_CLICKER
```

## boards/renesas/rsk_rx130_512kb/rsk_rx130_512kb_defconfig
```kconfig
# Copyright (c) 2024 Renesas Electronics Corporation
# SPDX-License-Identifier: Apache-2.0

# enable GPIO
CONFIG_GPIO=y

# enable uart driver
CONFIG_SERIAL=y
CONFIG_UART_INTERRUPT_DRIVEN=y

# enable console
CONFIG_CONSOLE=y
CONFIG_UART_CONSOLE=y

CONFIG_CLOCK_CONTROL=y
```

## boards/seeed/wio_terminal/Kconfig
```kconfig
# Copyright (c) 2024 Nordic Semiconductor ASA
# SPDX-License-Identifier: Apache-2.0

if BOARD_WIO_TERMINAL

config BOARD_NEED_SERIAL_BACKEND_CDC_ACM
	bool
	default y

endif # BOARD_WIO_TERMINAL
```

## boards/seeed/wio_terminal/Kconfig.defconfig
```kconfig
# Copyright (c) 2023 Joel Guittet
# Wio Terminal  board configuration

# SPDX-License-Identifier: Apache-2.0

if BOARD_WIO_TERMINAL

config LV_COLOR_16_SWAP
	default y if LVGL

source "${ZEPHYR_BASE}/boards/common/usb/Kconfig.cdc_acm_serial"

endif # BOARD_WIO_TERMINAL
```
