/*
 * Copyright (c) 2024 Nordic Semiconductor ASA
 *
 * SPDX-License-Identifier: Apache-2.0
 */

#include <nordic/nrf54l_05_10_15.dtsi>

/* 72 + 24 = 96KB */
&cpuapp_sram {
	reg = <0x20000000 DT_SIZE_K(72)>;
	ranges = <0x0 0x20000000 DT_SIZE_K(72)>;
};

&cpuflpr_sram {
	reg = <0x2002f000 DT_SIZE_K(24)>;
	ranges = <0x0 0x2002f000 DT_SIZE_K(24)>;
};

/* 470 + 30 = 500KB */
&cpuapp_rram {
	reg = <0x0 DT_SIZE_K(470)>;
};

&cpuflpr_rram {
	reg = <0x0 DT_SIZE_K(30)>;
};
