/*
 * Copyright (c) 2024 Nordic Semiconductor ASA
 *
 * SPDX-License-Identifier: Apache-2.0
 */

#include <nordic/nrf54l_05_10_15.dtsi>

/* 144 + 48 = 192KB */
&cpuapp_sram {
	reg = <0x20000000 DT_SIZE_K(144)>;
	ranges = <0x0 0x20000000 DT_SIZE_K(144)>;
};

&cpuflpr_sram {
	reg = <0x2002f000 DT_SIZE_K(48)>;
	ranges = <0x0 0x2002f000 DT_SIZE_K(48)>;
};

/* 960 + 62 = 1022KB */
&cpuapp_rram {
	reg = <0x0 DT_SIZE_K(960)>;
};

&cpuflpr_rram {
	reg = <0x0 DT_SIZE_K(62)>;
};
