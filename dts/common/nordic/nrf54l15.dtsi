/*
 * Copyright (c) 2024 Nordic Semiconductor ASA
 *
 * SPDX-License-Identifier: Apache-2.0
 */

#include <nordic/nrf54l_05_10_15.dtsi>

/* 188 + 68 = 256KB */
&cpuapp_sram {
	reg = <0x20000000 DT_SIZE_K(188)>;
	ranges = <0x0 0x20000000 DT_SIZE_K(188)>;
};

&cpuflpr_sram {
	reg = <0x2002f000 DT_SIZE_K(68)>;
	ranges = <0x0 0x2002f000 DT_SIZE_K(68)>;
};

/* 1428 + 96 = 1524KB */
&cpuapp_rram {
	reg = <0x0 DT_SIZE_K(1428)>;
};

&cpuflpr_rram {
	reg = <0x0 DT_SIZE_K(96)>;
};
